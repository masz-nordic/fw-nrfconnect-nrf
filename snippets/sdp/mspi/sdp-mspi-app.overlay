/*
 * Copyright (c) 2024 Nordic Semiconductor ASA
 *
 * SPDX-License-Identifier: LicenseRef-Nordic-5-Clause
 */


/* TIMER peripheral as a watchdog for SDP FW */
fault_timer: &timer20 {
	status = "okay";
	prescaler = <4>;
};
